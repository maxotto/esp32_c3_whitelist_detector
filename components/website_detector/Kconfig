## components/website_detector/Kconfig
```kconfig
# Component configuration

menu "Website Detector"

config WEBSITE_DETECTOR_ENABLED
    bool "Enable Website Detector"
    default y
    help
      Enable the Website Detector component

endmenu
```

## components/wifi_controller/Kconfig
```kconfig
# Component configuration

menu "WiFi Controller"

config WIFI_CONTROLLER_ENABLED
    bool "Enable WiFi Controller"
    default y
    help
      Enable the WiFi Controller component

endmenu
```
